## Kconfig
```kconfig
mainmenu "RT-Thread Configuration"

# Bsp Path
config $BSP_DIR
    string
    option env="BSP_ROOT"
    default "."

# RT-Thread Path
config $RTT_DIR
    string
    default "rt-thread"

# Package Path
config $PKGS_DIR
    string
    option env="PKGS_ROOT"
    default "packages"

# Config Bsp CPU is ARM CORTEX M4
config SOC_STM32H750VB
    bool 
    select ARCH_ARM_CORTEX_M7
    default y

# RT-Thread Kernel Configuration
source "$RTT_DIR/Kconfig"

# Online Package Configuration
source "$PKGS_DIR/Kconfig"

# Bsp board Configuration
source "$BSP_DIR/board/Kconfig" 
```

## board/Kconfig
```kconfig
menu "STM32 Bsp Config" 
source "$BSP_DIR/board/libstm32hal/Kconfig" 
source "$BSP_DIR/board/drives/Kconfig" 
endmenu 
```

## board/drives/Kconfig
```kconfig
menu "STM32 Bsp Config" 

menu "UART"
    config BSP_ENABLE_UART
        bool "Enable uart drive"
        select RT_USING_SERIAL
        default y      

    config BSP_UART_ENABLE_PORT3
        bool "Enable uart3 port"
        depends on BSP_ENABLE_UART
        default n    
endmenu

menu "PIN"
    config BSP_ENABLE_PIN
        bool "Enable pin drive"
        select RT_USING_PIN
        default y       
endmenu

menu "SDCRAD"
    config BSP_ENABLE_SDCARD
        bool "Enable sdcard drive" 
        default y 
        select RT_USING_DFS
        select RT_USING_DFS_ELMFAT

    config BSP_SDCARD_ENABLE_AUTO_MOUNT
        bool "Enable sdcard auto mount mode" 
        default y 
        depends on BSP_ENABLE_SDCARD
    
    config BSP_SDCARD_CONFIG_MOUNT_POINT
        string "Mount point"
        default "/mnt/sdcard" 
        depends on BSP_SDCARD_ENABLE_AUTO_MOUNT
endmenu

menu "SPI"
    config BSP_ENABLE_SPI
        bool "Enable spi bus drive"
        select RT_USING_SPI
        default n     

    config BSP_SPI_ENABLE_PORT3
        bool "Enable spi3 bus port"
        depends on BSP_ENABLE_SPI
        default n   

    config BSP_SPI_ENABLE_PORT4
        bool "Enable spi4 bus port"
        depends on BSP_ENABLE_SPI
        default n        
endmenu

menu "LCD"
    config BSP_ENABLE_LCD
        bool "Enable lcd drive"
        select RT_USING_SPI
        default n       
endmenu

endmenu 
```

## board/libstm32hal/Kconfig
```kconfig
choice
    prompt "HAL"
    default LIBSTM32HAL_USING_LIB

    config LIBSTM32HAL_USING_LIB
        bool "LIB"
    config LIBSTM32HAL_USING_SRC
        bool "CODE" 
endchoice
```
